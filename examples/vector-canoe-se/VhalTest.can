/*@!Encoding:1252*/
// SPDX-FileCopyrightText: 2026 Vector Informatik GmbH
// SPDX-License-Identifier: MIT
includes 
{
  #include "VhalUtils.cin"
}

export testcase CheckEvBatteryProperties()
{
    int status = 0;
    long propertyValue = -1;
    long apiVersion = -1;
    float propertyValueFloat = -1.0;

    // Confirm the bridge speaks this VCDL before anything else. Without it a
    // contract mismatch shows up as every later step timing out, which says
    // nothing about the cause.
    status = VhalGetApiVersion(apiVersion);
    if (status > 0 && apiVersion == 1) {
        testStepPass("0.1", "Bridge serves VhalSimple API v%d", apiVersion);
    } else {
        testStepFail("0.1", "No usable VhalSimple API: status=%d, version=%d (expected 1). Is the bridge running with matching --namespace/--instance?", status, apiVersion);
        return;
    }

    Write("Setting initial default values for properties");
    status = VhalSetInt32("EV_CHARGE_PORT_CONNECTED", 0);
    status = VhalSetFloat("EV_CURRENT_BATTERY_CAPACITY", 10); //kWh
    status = VhalSetFloat("EV_BATTERY_LEVEL", 0.0);
    status = VhalSetFloat("RANGE_REMAINING", 0);
    TestWaitForTimeout(1000);

    Write("Setting EV_CHARGE_PORT_CONNECTED to 1 (connected)");
    status = VhalSetInt32("EV_CHARGE_PORT_CONNECTED", 1);
    status = VhalGetInt32("EV_CHARGE_PORT_CONNECTED", propertyValue);

    if (propertyValue == 1) {
        testStepPass("1.0", "EV_CHARGE_PORT_CONNECTED is 1 as expected");
    } else {
        testStepFail("1.0", "EV_CHARGE_PORT_CONNECTED expected 1, got %d", propertyValue);
    }

    Write("Setting EV_BATTERY_LEVEL to 10000.0");
    status = VhalSetFloat("EV_BATTERY_LEVEL", 10000.0);
    TestWaitForTimeout(1000);

    Write("Setting EV_BATTERY_LEVEL to 30000.0");
    status = VhalSetFloat("EV_BATTERY_LEVEL", 30000.0);
    TestWaitForTimeout(1000);

    Write("Setting EV_BATTERY_LEVEL to 80000.0");
    status = VhalSetFloat("EV_BATTERY_LEVEL", 80000.0);
    TestWaitForTimeout(1000);

    Write("Setting EV_BATTERY_LEVEL to 100000.0");
    status = VhalSetFloat("EV_BATTERY_LEVEL", 100000.0);
    TestWaitForTimeout(1000);

    status = VhalGetFloat("EV_BATTERY_LEVEL", propertyValueFloat);
    if (propertyValueFloat == 100000.0 && status > 0) {
        testStepPass("1.0", "EV_BATTERY_LEVEL is 100000.0 as expected");
    } else {
        Write("EV_BATTERY_LEVEL is %f, expected 100000.0, status=%d", propertyValueFloat, status);
        testStepFail("1.0", "EV_BATTERY_LEVEL expected 100000.0, got %f", propertyValueFloat);
    }

    //VhalGetFloat("NON_EXISTING", propertyValueFloat);

    testWaitForTimeout(3000);
    status = VhalSetInt32("EV_CHARGE_PORT_CONNECTED", 0);
    status = VhalSetFloat("RANGE_REMAINING", 1337);

    testStepPass("1.0", "Test completed");
}

// Exercises one property per VhalSimple type against the seeded --mock values, so
// a single run tells you which of the five method families works end to end.
// Expected seed values are in source/VhalMockClient.hpp; each step reads the
// seeded value first, then writes and reads back.
export testcase CheckAllPropertyTypes()
{
    int status = 0;
    long apiVersion = -1;
    long i32 = -1;
    int64 i64 = -1;
    float f32 = -1.0;
    char text[128] = "";
    byte blob[64];
    byte newSeed[4] = {0xCA, 0xFE, 0xBA, 0xBE};
    long blobLen = -1;

    status = VhalGetApiVersion(apiVersion);
    if (status > 0 && apiVersion == 1) {
        testStepPass("0.1", "Bridge serves VhalSimple API v%d", apiVersion);
    } else {
        testStepFail("0.1", "No usable VhalSimple API: status=%d, version=%d (expected 1)", status, apiVersion);
        return;
    }

    // ---- int32 : INFO_MODEL_YEAR, seeded 2026 ----
    status = VhalGetInt32("INFO_MODEL_YEAR", i32);
    if (status > 0 && i32 == 2026) {
        testStepPass("1.1", "int32 read: INFO_MODEL_YEAR = %d", i32);
    } else {
        testStepFail("1.1", "int32 read failed: status=%d, value=%d (expected 2026)", status, i32);
    }
    status = VhalSetInt32("INFO_MODEL_YEAR", 2027);
    status = VhalGetInt32("INFO_MODEL_YEAR", i32);
    if (status > 0 && i32 == 2027) {
        testStepPass("1.2", "int32 round trip: INFO_MODEL_YEAR = %d", i32);
    } else {
        testStepFail("1.2", "int32 round trip failed: status=%d, value=%d (expected 2027)", status, i32);
    }

    // ---- int32 carrying an AOSP BOOLEAN : EV_CHARGE_PORT_CONNECTED, seeded 1 ----
    status = VhalGetInt32("EV_CHARGE_PORT_CONNECTED", i32);
    if (status > 0 && i32 == 1) {
        testStepPass("2.1", "boolean read: EV_CHARGE_PORT_CONNECTED = %d", i32);
    } else {
        testStepFail("2.1", "boolean read failed: status=%d, value=%d (expected 1)", status, i32);
    }
    status = VhalSetInt32("EV_CHARGE_PORT_CONNECTED", 0);
    status = VhalGetInt32("EV_CHARGE_PORT_CONNECTED", i32);
    if (status > 0 && i32 == 0) {
        testStepPass("2.2", "boolean round trip: EV_CHARGE_PORT_CONNECTED = %d", i32);
    } else {
        testStepFail("2.2", "boolean round trip failed: status=%d, value=%d (expected 0)", status, i32);
    }

    // ---- int64 : ANDROID_EPOCH_TIME, seeded 1767225600000 (beyond 32 bits) ----
    status = VhalGetInt64("ANDROID_EPOCH_TIME", i64);
    if (status > 0 && i64 == 1767225600000LL) {
        testStepPass("3.1", "int64 read: ANDROID_EPOCH_TIME = %I64d", i64);
    } else {
        testStepFail("3.1", "int64 read failed: status=%d, value=%I64d (expected 1767225600000)", status, i64);
    }
    status = VhalSetInt64("ANDROID_EPOCH_TIME", 1800000000000LL);
    status = VhalGetInt64("ANDROID_EPOCH_TIME", i64);
    if (status > 0 && i64 == 1800000000000LL) {
        testStepPass("3.2", "int64 round trip: %I64d", i64);
    } else {
        testStepFail("3.2", "int64 round trip failed: status=%d, value=%I64d (a 32-bit truncation shows up here)", status, i64);
    }

    // ---- float : EV_BATTERY_LEVEL, seeded 88.5 ----
    status = VhalGetFloat("EV_BATTERY_LEVEL", f32);
    if (status > 0 && f32 > 88.4 && f32 < 88.6) {
        testStepPass("4.1", "float read: EV_BATTERY_LEVEL = %f", f32);
    } else {
        testStepFail("4.1", "float read failed: status=%d, value=%f (expected 88.5)", status, f32);
    }
    status = VhalSetFloat("EV_BATTERY_LEVEL", 42.25);
    status = VhalGetFloat("EV_BATTERY_LEVEL", f32);
    if (status > 0 && f32 > 42.2 && f32 < 42.3) {
        testStepPass("4.2", "float round trip: EV_BATTERY_LEVEL = %f", f32);
    } else {
        testStepFail("4.2", "float round trip failed: status=%d, value=%f (expected 42.25)", status, f32);
    }

    // ---- string : INFO_VIN, seeded "WVWZZZ1JZXW000001" ----
    status = VhalGetString("INFO_VIN", text);
    if (status > 0 && strncmp(text, "WVWZZZ1JZXW000001", 17) == 0) {
        testStepPass("5.1", "string read: INFO_VIN = %s", text);
    } else {
        testStepFail("5.1", "string read failed: status=%d, value='%s' (expected WVWZZZ1JZXW000001)", status, text);
    }
    status = VhalSetString("INFO_VIN", "TESTVIN0000000001");
    status = VhalGetString("INFO_VIN", text);
    if (status > 0 && strncmp(text, "TESTVIN0000000001", 17) == 0) {
        testStepPass("5.2", "string round trip: INFO_VIN = %s", text);
    } else {
        testStepFail("5.2", "string round trip failed: status=%d, value='%s'", status, text);
    }

    // ---- bytes : STORAGE_ENCRYPTION_BINDING_SEED, seeded DE AD BE EF ----
    // Reading is confirmed working: the seeded DE AD BE EF renders correctly in
    // the CANoe trace window. A vCDL "bytes" value is a CAPL byte array here, so
    // a payload containing 0x00 is carried fine - unlike a char array. The length
    // comes from elcount() inside the wrapper, so a short or over-long response is
    // caught rather than silently compared against stale buffer contents.
    status = VhalGetBytes("STORAGE_ENCRYPTION_BINDING_SEED", blob, blobLen);
    if (status > 0 && blobLen == 4 && blob[0] == 0xDE && blob[1] == 0xAD && blob[2] == 0xBE && blob[3] == 0xEF) {
        testStepPass("6.1", "bytes read: %d bytes, %02X %02X %02X %02X", blobLen, blob[0], blob[1], blob[2], blob[3]);
    } else {
        testStepFail("6.1", "bytes read failed: status=%d, len=%d, %02X %02X %02X %02X (expected 4 bytes DE AD BE EF)", status, blobLen, blob[0], blob[1], blob[2], blob[3]);
    }
    status = VhalSetBytes("STORAGE_ENCRYPTION_BINDING_SEED", newSeed);
    status = VhalGetBytes("STORAGE_ENCRYPTION_BINDING_SEED", blob, blobLen);
    if (status > 0 && blobLen == 4 && blob[0] == 0xCA && blob[1] == 0xFE && blob[2] == 0xBA && blob[3] == 0xBE) {
        testStepPass("6.2", "bytes round trip: %d bytes, %02X %02X %02X %02X", blobLen, blob[0], blob[1], blob[2], blob[3]);
    } else {
        testStepFail("6.2", "bytes round trip failed: status=%d, len=%d, %02X %02X %02X %02X (expected 4 bytes CA FE BA BE)", status, blobLen, blob[0], blob[1], blob[2], blob[3]);
    }

    // ---- a property the mock does not seed: the bridge answers with a default ----
    // There is no status out-parameter in the VCDL, so this is 0, not an error.
    // The bridge log is where the reason appears.
    status = VhalGetInt32("NOT_A_REAL_PROPERTY", i32);
    if (status > 0 && i32 == 0) {
        testStepPass("7.1", "unknown property answered with the 0 default, as documented");
    } else {
        testStepFail("7.1", "unknown property: status=%d, value=%d (expected status>0 and 0)", status, i32);
    }

    testStepPass("8.0", "All VhalSimple types exercised");
}
