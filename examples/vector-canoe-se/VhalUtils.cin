/*@!Encoding:1252*/
// SPDX-FileCopyrightText: 2026 Vector Informatik GmbH
// SPDX-License-Identifier: MIT

// CAPL wrappers for the VhalSimple API. Keep in sync with VhalSimple.vcdl.
// Every wrapper returns the testWaitForAnswer status: > 0 on success, <= 0 when
// the call did not complete (most often because the bridge is not running or its
// --namespace/--instance do not match this VCDL).
variables
{
    int maxWait = 100; //milliseconds

    // GetPropertyStatus bits. Keep in sync with VhalSimpleApi::PropertyStatus in
    // source/VhalSimpleApi.hpp - CAPL cannot include that header, so these are
    // restated by hand and Test_VhalSimpleApi pins the numbers on the other side.
    long kVhalPropExists    = 0x01;
    long kVhalPropReadable  = 0x02;
    long kVhalPropWritable  = 0x04;
    long kVhalPropKnownName = 0x08;

    // Which accessor the property needs, in bits 8-11.
    long kVhalPropTypeShift = 8;
    long kVhalPropTypeMask  = 0x0F;
    long kVhalTypeNone      = 0;
    long kVhalTypeInt32     = 1;
    long kVhalTypeInt64     = 2;
    long kVhalTypeFloat     = 3;
    long kVhalTypeString    = 4;
    long kVhalTypeBytes     = 5;
}

// Contract version served by the bridge. Compare against the value this VCDL was
// written for; a mismatch explains an otherwise silent failure to match.
int VhalGetApiVersion(long& value)
{
    int status = -1;
    callcontext properties.GetApiVersion cc;
    cc = properties.GetApiVersion.CallAsync();
    status = testWaitForAnswer(cc, maxWait);
    if(status > 0) {
        value = cc.Result;
    }
    return status;
}

// Capability query for one property. The result is a bitfield, so mask the bit
// you care about rather than comparing the whole value - see VhalSimple.vcdl for
// the layout. A result of 0 means the name is unknown to the bridge entirely; a
// negative result means the bridge could not reach the VHAL.
//
// This is the only way to tell "the property is 0" from "there is no such
// property": every Get<Type> answers both with 0.
//
// A bridge that does not serve the method never matches this client, so the
// call returns ServerNotReachable, which arrives here as status <= 0. Check the
// return code before the bitfield, always.
int VhalGetPropertyStatus(char name[], long& propertyStatus)
{
    int status = -1;
    callcontext properties.GetPropertyStatus cc;
    // Cleared before the call, not left as the caller passed it. Every other
    // wrapper here leaves its out-parameter untouched on failure, which is
    // harmless for a value but not for a bitfield: a caller who initialised it
    // to -1 and then followed the documented "mask the bit you care about"
    // advice would read 0xFFFFFFFF as exists+readable+writable+known-name with
    // an undefined type nibble. 0 is the one value that reads as "nothing".
    propertyStatus = 0;
    cc = properties.GetPropertyStatus.CallAsync(name);
    status = testWaitForAnswer(cc, maxWait);
    if(status > 0) {
        propertyStatus = cc.Result;
    }
    return status;
}

// Which Get<Type>/Set<Type> pair addresses this property: one of the kVhalType*
// values above. Call it on a status word that VhalGetPropertyStatus produced.
long VhalPropertyType(long propertyStatus)
{
    return (propertyStatus >> kVhalPropTypeShift) & kVhalPropTypeMask;
}

// ---- int32 (also carries AOSP BOOLEAN properties, as 0/1) ----

int VhalSetInt32(char name[], long value)
{
    callcontext properties.SetInt32 cc;
    cc = properties.SetInt32.CallAsync(name, value);
    return testWaitForAnswer(cc, maxWait);
}

int VhalGetInt32(char name[], long& value)
{
    int status = -1;
    callcontext properties.GetInt32 cc;
    cc = properties.GetInt32.CallAsync(name);
    status = testWaitForAnswer(cc, maxWait);
    if(status > 0) {
        value = cc.Result;
    }
    return status;
}

// ---- int64 ----

int VhalSetInt64(char name[], int64 value)
{
    callcontext properties.SetInt64 cc;
    cc = properties.SetInt64.CallAsync(name, value);
    return testWaitForAnswer(cc, maxWait);
}

int VhalGetInt64(char name[], int64& value)
{
    int status = -1;
    callcontext properties.GetInt64 cc;
    cc = properties.GetInt64.CallAsync(name);
    status = testWaitForAnswer(cc, maxWait);
    if(status > 0) {
        value = cc.Result;
    }
    return status;
}

// ---- float ----

int VhalSetFloat(char name[], float value)
{
    callcontext properties.SetFloat cc;
    cc = properties.SetFloat.CallAsync(name, value);
    return testWaitForAnswer(cc, maxWait);
}

int VhalGetFloat(char name[], float& value)
{
    int status = -1;
    callcontext properties.GetFloat cc;
    cc = properties.GetFloat.CallAsync(name);
    status = testWaitForAnswer(cc, maxWait);
    if(status > 0) {
        value = cc.Result;
    }
    return status;
}

// ---- string ----

int VhalSetString(char name[], char value[])
{
    callcontext properties.SetString cc;
    cc = properties.SetString.CallAsync(name, value);
    return testWaitForAnswer(cc, maxWait);
}

int VhalGetString(char name[], char value[])
{
    int status = -1;
    callcontext properties.GetString cc;
    cc = properties.GetString.CallAsync(name);
    status = testWaitForAnswer(cc, maxWait);
    if(status > 0) {
        strncpy(value, cc.Result, elcount(value));
    }
    return status;
}

// ---- bytes ----

// A vCDL "bytes" parameter is a plain CAPL byte array at the call site. Vector's
// own IoTEnablerBLE sample declares
//   consumed method result write(string name, bytes data);
// and calls it as write.CallAsync("RSSI/value", rssi) with a "byte rssi[1]",
// which is the same (string, bytes) shape as SetBytes here. A char array does
// not compile - that is the mapping for vCDL "string" - and the CAPL compiler
// reports "types of parameters do not match".
//
// elcount() on a bytes value gives the number of bytes actually present, which
// is how the same sample bounds its reads, so VhalGetBytes can report the length
// rather than leaving the caller to guess. memcpy copies the whole value, so
// size the destination for the largest property you read; the length is returned
// so an oversized result is at least detectable.
int VhalSetBytes(char name[], byte value[])
{
    callcontext properties.SetBytes cc;
    cc = properties.SetBytes.CallAsync(name, value);
    return testWaitForAnswer(cc, maxWait);
}

int VhalGetBytes(char name[], byte value[], long& length)
{
    int status = -1;
    callcontext properties.GetBytes cc;
    cc = properties.GetBytes.CallAsync(name);
    status = testWaitForAnswer(cc, maxWait);
    length = 0;
    if(status > 0) {
        length = elcount(cc.Result);
        memcpy(value, cc.Result);
    }
    return status;
}
